#include "delay.h"

// 条件编译STM32库
#ifdef STM32F4XX
#include "stm32f4xx.h"
#else
extern uint32_t SystemCoreClock;
#endif

/**********************************************************************************************************
延时相关变量
**********************************************************************************************************/
static volatile uint32_t TimingDelay = 0;
static volatile uint32_t system_tick_count = 0;

/**********************************************************************************************************
函数名称：延时初始化（统一接口）
输入参数：无
输出参数：无
**********************************************************************************************************/
void delay_init(void)
{
    SysTick_Init();
}

/**********************************************************************************************************
函数名称：系统滴答时钟初始化
输入参数：无
输出参数：无
**********************************************************************************************************/
void SysTick_Init(void)
{
#ifdef STM32F4XX
    // 设置SysTick为1ms中断
    if (SysTick_Config(SystemCoreClock / 1000))
    {
        // 错误处理：进入死循环前可以尝试其他处理
        while (1);
    }
#else
    // 非STM32平台的简单实现
    system_tick_count = 0;
#endif
}

/**********************************************************************************************************
函数名称：ms延时函数
输入参数：延时时间（毫秒）
输出参数：无
**********************************************************************************************************/
void delay_ms(uint32_t time)
{
    if(time == 0) return;
    
#ifdef STM32F4XX
    TimingDelay = time;
    while(TimingDelay != 0);
#else
    // 简单的软件延时（不准确，仅用于兼容性）
    volatile uint32_t i, j;
    for(i = 0; i < time; i++) {
        for(j = 0; j < 1000; j++) {
            __asm__("nop");
        }
    }
#endif
}

/**********************************************************************************************************
函数名称：us延时函数，最小延时为1us
输入参数：延时时间（微秒）
输出参数：无
**********************************************************************************************************/
void delay_us(uint32_t time)
{
    if(time == 0) return;
    
#ifdef STM32F4XX
    volatile uint32_t i = 0;
    
    while(time--) {
        i = 13;  // 根据系统时钟调整此值
        while(i--);
    }
#else
    // 简单的软件延时
    volatile uint32_t i, j;
    for(i = 0; i < time; i++) {
        for(j = 0; j < 10; j++) {
            __asm__("nop");
        }
    }
#endif
}

/**********************************************************************************************************
函数名称：延时递减函数（在SysTick中断中调用）
输入参数：无
输出参数：无
**********************************************************************************************************/
void TimingDelay_Decrement(void)
{
    if (TimingDelay != 0) {
        TimingDelay--;
    }
    
    // 更新系统时钟计数
    system_tick_count++;
}

/**********************************************************************************************************
函数名称：获取系统毫秒时钟
输入参数：无
输出参数：系统运行时间（毫秒）
**********************************************************************************************************/
uint32_t get_system_ms(void)
{
    return system_tick_count;
}

/**********************************************************************************************************
函数名称：获取系统时钟节拍（兼容LVGL）
输入参数：无
输出参数：系统运行时间（毫秒）
注意：此函数已删除，使用LVGL标准库中的lv_tick_get()
**********************************************************************************************************/
